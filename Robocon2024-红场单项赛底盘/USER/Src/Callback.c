/**
 * @file Callback.c
 * @author 陶子辰 (2405973406@qq.com)
 * @brief hal库中断回调函数的实现
 * @version 1.0
 * @date 2023-07-12
 * 
 * @copyright Copyright (c) 2023
 * 
 */

/*
*********************************************************************************************************
*                                             INCLUDE FILES
*********************************************************************************************************
*/
#include "main.h"
#include "SBUS.h"

/**
 * @brief CANFIFO0接收中断回调函数
 * 
 * @param hcan CAN句柄
 */
void HAL_CAN_RxFifo0MsgPendingCallback(CAN_HandleTypeDef *hcan)
{
    CAN_RxHeaderTypeDef rx_header;
    uint8_t rx_data[8];
    HAL_CAN_GetRxMessage(&hcan1, CAN_RX_FIFO0, &rx_header, rx_data);
    switch(rx_header.StdId)
    {
        case 0x201:
        case 0x202:
        case 0x203:
        case 0x204:
        case 0x205:
        case 0x206:
        case 0x207:
        case 0x208:
            M3508_Analyze(rx_header.StdId, rx_data);
            break;
    }
 
}

/**
 * @brief 串口接收中断回调函数
 * 
 * @param huart 串口句柄
 * @param Size 接受到的字节数
 */
void HAL_UARTEx_RxEventCallback(UART_HandleTypeDef *huart, uint16_t Size)
{
//	if(huart->Instance == USART3)
//	{
//        if(Size==25)
//		SBUS_Analyze();
//        HAL_UARTEx_ReceiveToIdle_IT(&huart3,SBUS_RX_BUF,SBUS_FRAME_SIZE);
//	}
//        if(huart->Instance == USART6)
//	{
//        for(int i=0;i<10;i++)
//    {
//      if(CCD_DATA_receive[i] == SBUS_Head && CCD_DATA_receive[i+1] == SBUS_Head_ && CCD_DATA_receive[i+36-1] == SBUS_Tail_ && CCD_DATA_receive[i+36-2] == SBUS_Tail)
//    {
//        CCD_DATA=CCD_DATA_receive[i+2];
//      break;
//    }
//    }
//       HAL_UART_Receive_IT(&huart6,CCD_DATA_receive,10);
//      }
      
}


void HAL_UART_RxCpltCallback(UART_HandleTypeDef *huart)
{
	//ACTION_Analyze();
	//HAL_UART_Receive_IT(&huart1, &Action_ch, 1);
    if(huart->Instance == USART6){
        SBUS_Receive_Analyze();
        HAL_UART_Receive_IT(&huart6, &SBUS_ch, 1);

    }
    if (huart->Instance == USART1)
    {      
         ACTION_Analyze();
	 HAL_StatusTypeDef return_state;
        return_state = HAL_UART_Receive_IT(&huart1, &Action_ch, 1);
        if (return_state != HAL_OK)
        {
            if (return_state == HAL_BUSY)
            {
                __HAL_UART_CLEAR_OREFLAG(&huart1);                                      // 濠电姷鏁告慨鐑藉极閸涘﹥鍙忛柣鎴ｆ閺嬩線鏌涘☉姗堟敾闁告瑥绻橀弻锝夊箣閿濆棭妫勯梺鍝勵儎缁舵岸寮诲☉妯锋婵鐗婇弫楣冩⒑閸涘﹦鎳冪紒缁橈耿瀵鏁愭径濠勵吅闂佹寧绻傚Λ顓炍涢崟顖涒拺闁告繂瀚烽崕搴ｇ磼閼搁潧鍝虹€殿喖顭烽幃銏ゅ礂鐏忔牗瀚介梺璇查叄濞佳勭珶婵犲伣锝夘敊閸撗咃紲闂佺粯鍔﹂崜娆撳礉閵堝棎浜滄い鎾跺Т閸樺鈧鍠栭…鐑藉极閹邦厼绶炲┑鐘插閺夊憡淇婇悙顏勨偓鏍暜婵犲洦鍊块柨鏇炲€哥壕鍧楁煙閹冾暢缁炬崘妫勯湁闁挎繂鎳忛幆鍫焊韫囨稒鈷戦柛娑樷看濞堟洖鈹戦悙璇у伐妞ゆ洩绲剧换婵嗩潩椤撶偘绨婚梻浣呵圭换鎰版儍閻戣棄绠┑鐘崇閻撶喖骞栧ǎ顒€濡芥繛鎳峰喚鐔嗛柣鐔峰簻瀹搞儵宕℃潏銊ｄ簻闁哄倸鐏濋埛鏃傜棯閹规劖顥夐棁澶愭煥濠靛棙鍣洪柟顖氱墦瀹曨垶宕ㄦ繝鍕槇濠电偛鐗嗛悘婵嬪几濞戙垺鐓熼煫鍥ㄦ⒐閻ㄦ垹绱掗鐣岊暡婵炵厧绻樻俊姝岊槾闁伙箑鐗撳娲箹閻愭彃濮ら梺绯曟櫆閻楃姴顕ｉ弻銉晢闁逞屽墴閸╃偤骞嬮敂钘変汗缂傚倷鐒﹁摫闂佹鍙冮弻锝嗘償閵忋垺顔囬梺鎼炲劀閸滃啰骞㈤梻鍌欐祰椤鐣峰鈧、姘愁樄闁诡喚鍋ゅ畷褰掝敃閻樿京鐩庨梻浣告贡閸庛倝宕归悽鍓叉晜妞ゅ繐鐗婇悡鐔兼煙閹屽殶婵炲弶鎸抽弻鐔碱敊缁涘鐤侀梺杞扮劍閸旀牠骞嗛弬搴撴斀闁割偆鍠愬▍锕傛⒒娴ｅ搫甯剁€殿喖鐖奸幃褔鎮╁顔界稁濠电偛妯婃禍婵嬫倿婵犳碍鐓熼柟閭﹀灠閽勫ジ鎮楀顓熺凡妞ゎ叀鍎婚¨渚€鏌涢悩铏殤婵″弶鍔欓獮鎺懳旀担闀愭睏闂備浇鍋愰埛鍫ュ磿閻ゎ垼妲鹃梺閫炲苯澧叉い顐㈩槸鐓ゆ俊顖氥偨濞差亝鍋勫瀣濞堟儳鈹戦埥鍡楃仩闁靛牅绮欏畷鐑筋敇濞戞ü澹曢梺鎸庣箓妤犲憡绂嶉悙鐑樼厓鐟滄粓宕滃顒夋富闁芥ê顦藉鏍ㄧ箾瀹割喕绨荤€瑰憡绻傞埞鎴︽偐閹绘帩浠煎銈庡€ら崶銊㈡嫼闂佺粯鍨熼弲婊冣枍閹剧粯鐓曢柕濞垮€曞畵鍡涙煥濠靛牆浠╃紒鐘崇洴瀵噣宕掑⿰鍛潓濠电姵顔栭崰妤呮晝閳哄懎绀堟繛鎴欏灪閺咁剚绻濇繝鍌氭殜闁衡偓娴犲鐓熼柟閭﹀墮缁狙勩亜閵壯冧槐闁哄本鐩崺鈩冩媴閸濆嫷鏆梺鍛�?殙妞存悂濡甸崟顖氬嵆婵°倐鍋撳ù�?勫劤閳规垿顢欑涵閿嬫暰濠碉紕鍋犲Λ鍕偩閻戣姤鍊荤紒娑橆儐閺咃絽鈹戦悙鏉戠仸闁荤喆鍎甸幃鐢告焼瀹ュ棌鎷绘繛杈剧到閹虫瑨銇愰幒婵囨櫈闂佸憡渚楅崢娆忊槈濡攱顫嶉梺闈涚箳婵兘藝椤愶附鈷戦柛锔诲幖閸斿銇勯妸銉﹀櫧闁绘碍鍎抽鍏煎緞鐎ｎ剙骞堟俊鐐€栭崝褏寰婄捄銊т笉婵☆垯缍嶉弮鍫熷亹闁告瑥顦弸鐘测攽椤旂》鏀绘俊鐐舵閻ｇ兘鎮滅粵瀣櫍闂佺粯鍔栨竟鍡欐閿曞倹鈷掑ù锝呮啞閸熺偤鏌＄仦璇插缂侇喗妫冮獮姗€顢欓崗澶婁壕闁哄啫鐗嗙粈鍐┿亜閺冨洦顥夋繛鍫㈠枛濮婃椽妫冨☉杈ㄐら梺绋匡攻椤ㄥ牏鍒掔拠宸僵闁煎摜顣介幏娲⒑閸涘﹥灏扮憸鏉垮暞缁傚秴鈹戦崶鈺冾啎闂佸憡鐟ラˇ杈ㄦ櫠閻㈠憡鐓欐い鏃傛櫕閹冲嫮绱掔紒妯肩疄鐎规洖鐖兼俊姝岊槻閻㈩垱鍎抽埞鎴︽偐閸偅姣勯梺绋款儐閻╊垶骞冨Ο琛℃斀閻庯綆浜為ˇ顔尖攽椤旇瑙勭椤掑倸顥氬┑鍌氭啞閻撳繐鈹戦悩鑼闁告帊鍗抽弻娑㈠籍閹剧粯顎嶉梺閫涚┒閸斿秶鎹㈠┑瀣妞ゆ挾鍋熼濂告⒒娴ｇ儤鍤€闁搞垺鐓￠獮濠傤潨閳ь剟鐛繝鍥ㄥ€烽柛婵嗗珋閵娧勫枑閻庯綆鍠栭悞鍨亜閹哄棗浜鹃梺鎸庢处娴滄粓锝炶箛鎾佹椽顢旈崪浣诡棃闂備礁鍟块幖顐﹀疮閹峰苯鈧绱撻崒姘偓鐑芥嚄閼�?灚鍙忛柣銏⑶圭粻鏌ユ煕閵夘喖澧柛瀣戦妵鍕籍閸ャ劎銆婇梺姹囧€愰崑鎾寸節閻㈤潧浠﹂柛銊ョ埣閹兘鏁冮埀顒勫煝瀹ュ顫呴柕鍫濇閹锋椽鏌ｉ悩鍏呰埅闁告柨鑻埢宥夊箛閻楀牏鍘甸梺鍛婂灟閸婃牜鈧熬鎷�?
                huart1.RxState = HAL_UART_STATE_READY;                                  // 闂傚倸鍊搁崐鎼佸磹閹间礁纾归柟闂寸绾惧綊鏌熼梻瀵割槮缁炬儳缍婇弻鐔兼⒒鐎靛壊妲紒鐐劤缂嶅﹪寮婚悢鍏尖拻閻庨潧澹婂Σ顔剧磼閻愵剙鍔ょ紓宥咃躬瀵鏁愭径濠勵吅闂佹寧绻傞幉娑㈠箻缂佹鍘遍梺闈涚墕閹冲酣顢旈銏＄厸閻忕偛澧藉ú瀛橆殽閻愯揪鑰块柟宕囧█椤㈡寰勭€ｆ挻绮撳缁樻媴鐟欏嫬浠╅梺鍛婃煥缁夊爼骞戦姀銈呯妞ゆ柨妲堥敃鍌涚厱闁哄洢鍔岄悘鐘绘煕閹般劌浜鹃梻鍌欑窔濞佳嗗櫣婵炶揪绲捐ぐ鍐╃妤ｅ啯鐓欓柣鎴灻▓顔炬喐閻楀牆绗氶柛瀣姍閺屾盯骞囬鐐电シ闂侀€涚矙濞佳囧煘閹达富鏁婄痪顓炲槻婵稓绱撴笟鍥ф珮闁搞劌鐖奸悰顔跨疀濞戞ê绐涢柣搴㈢⊕钃遍柛搴簻铻栭柣姗€娼ф禒�?呯磼閵娾晙鎲剧€规洘鍨块獮妯尖偓闈涙憸閻﹀牓姊洪幖鐐插姌闁告柨閰ｅ畷銏ゅ箹娴ｅ厜鎷洪梺鍛婄☉閿曪絿娆㈤柆宥嗙厱闁绘ê鍟块崫娲煙椤栨氨鐒告鐐村笒铻栧ù锝呮惈楠炲秵淇婇悙顏勨偓鏍蓟閿濆绀夐悘鐐电叓濞差亝鏅濋柛灞炬皑閿涙盯姊虹憴鍕棆濠⒀勵殜瀹曟垿鏁愭径瀣幈闂侀潧顦伴崹鐢�?疮閻楀牜娈介柛銉戔偓閺€浠嬫煃閵夈劍鐝柍缁樻礋閺屾盯骞樼捄鐑樼€诲銈庡亜缁绘劗鍙呭銈呯箰閹虫劙宕濋悽鍛娾拺缂備焦锚婵矂鎮�?箛锝勭敖闁逞屽墯绾板秴顭垮鈧垾锕傛嚄椤栵絾顎囬梻浣规偠閸斿矂鎮ラ悡搴殨濠电姵鑹鹃崡鎶芥煏韫囨洖啸闁�?﹦鍋ら幃宄扳堪閸愵€勩亜閵忊剝顥堟い銏★耿閹倖鎷呯拠鈥虫櫖闂傚倷鑳剁划顖炲礉閺囩倣鐔哥節閸パ咃紵闂佸搫鍟悧濠囨偂濞嗘劑浜滈柡鍐ㄥ€瑰▍鏇㈡煙閸愭彃鏆為柕鍥у瀵剛鎹勯妸褜鍟嬫俊鐐€戦崹娲偡閳轰胶鏆︽俊銈呮噺閸ゅ啴鏌嶉崫鍕偓鍦椤撶姷纾介柛灞捐壘閳ь剚鎮傚畷鎰板箹娴ｅ摜锛欓梺褰掓？缁€浣哄閸︻厸鍋撻悷鏉款伃闁稿锕ら妴鎺撶節濮橆厾鍘甸梺缁樺灦閿曗晛鈻撻弴銏＄厱闁靛牆鎳庨顓㈡煛鐏炶鈧鍒掑▎鎴炲磯闁靛ǹ鍊楁す铏節閻㈤潧浠滈柟铏姈閹便劑宕归銈傛敵婵犵數濮村ú銈呮纯闂備礁鎲℃笟妤呭窗閺嵮€鏋嶉柨婵嗘缁诲棙淇婇妶鍌氫壕闂佺娅曢敋妞ゎ偄绻愮叅妞ゅ繐瀚粣娑欑節閻㈤潧孝闁哥噥鍋婅棟闁冲搫鎳忛埛鎴︽煙閼测晛浠滃┑陇妫勯…鍧楁偡閻楀牜妫﹂梺璇″櫘閸ｏ綁鐛崱姘兼闂佸憡鑹鹃鍛粹€︾捄銊﹀磯濞撴凹鍨伴崜鎶芥⒑閸涘鎴﹀箲閸ヮ剙绠栫€瑰嫭澹嬮崼顏堟煕閺囥劌骞橀柣鎾愁樀閹鎲撮崟顒傤槰缂備緡鍠栭惌鍌炲春閵忊剝鍎熼柕濞垮劤椤撳搫鈹戦悩缁樻锭婵☆偅鐩鏄忣槼缂佺粯绻堥幃浠嬫濞磋翰鍎甸弻鈩冩媴閸涘﹤鏆堥梺閫涚┒閸旀垿鐛鈧、娆撴嚍閵夛妇褰囬梻鍌欑窔濞佳囨偋閸℃蛋鍥敍濠婂懍绗夐梺缁樓瑰畷鐢稿矗閹剧粯鐓曢柕澶涚到婵″ジ鏌涢悩铏缂佽鲸鎸搁濂�?幢濞嗗繆鎷伴梻浣告惈閻鎹㈠┑鍡欐殾闁割偅娲栧敮闂侀潧锛忛崒婊勶紡闂傚倸鍊烽懗鍓佸垝椤栫偛绠板┑鐘崇閸庡孩銇勯弽顐粶闁藉啰鍠愮换娑㈠箣濞嗗繒浠肩紓浣哄У閻╊垶寮诲鍡樺闁规鍣Σ顔碱渻閵堝骸澧い鎴濇閹广垹鈹戠€ｎ亞鍘遍梺閫炲苯澧寸€规洖鐖奸弫鍌炴寠婢跺浜鹃梻鍌氬€风粈渚€骞栭锝呯窞闁搞儺鍓欑粈鍫熺節闂堟侗鍎忕紒鐙€鍨堕弻娑樷槈濡吋鎲煎銈冨劚閻楁捇寮诲澶婁紶闁告洦鍋掓禒濂告⒑鐠団€崇仩闁绘鎸搁～蹇曠磼濡顎撻梺鍛婄☉閿曘儵宕曢幘缁樷拺婵炶尪顕ч獮鏍ㄣ亜閿曞倷鎲炬鐐村灴婵偓闁绘﹩鍋呴弬鈧梻浣虹《閸撴繈鎮烽敃鈧埢鎾淬偅閸愨斁鎷虹紓鍌欑劍钃遍柍閿嬪浮閺屽秴鐣￠幍顔尖叺閻庢鍣崑濠傜暦濮椻偓椤㈡瑩鎮剧仦钘夊闂傚倷绀佹竟濠囧磻閸涱垱宕查柛鎰典簽閻牓鏌嶉崫鍕櫤闁绘挻娲熼弻锝夊箛閻楀牊閿梺鍛婃煥椤戝懓褰侀梺鎼炲劀瀹ュ牆鎯堥梻浣筋嚃閸犳鎮烽埡鍛偓渚€寮崼婵堫槹闂侀潧枪閸庣増绔熼弴銏″仭婵犲﹤鍟扮粻铏繆閸欏濮嶆鐐达耿楠炲洦鎷呴悷鏉垮帪闂備浇宕垫繛鈧紓鍌涜壘閳诲秹鏁愭径鍫氬亾娓氣偓瀹曘劎鈧稒菤閹锋椽姊洪崨濠勨槈闁挎洏鍊栭幈銊╁炊閵娿倗绠氬銈嗙墬閻旑剙顔忛妷锔轰簻妞ゆ挾鍋為崰妯尖偓娈垮枙缁瑦淇婂宀婃Ь濡炪倖姊瑰ú鐔煎箖濡ゅ懏鍋￠柡澶嬵儥濡矂姊洪崫銉バｆ繛鍙夌矒閹崇偤鏌嗗鍡楁闂侀潧鐗嗛崐鍛婄妤ｅ啯鐓熼柣鏂挎惈椤ｅジ鏌涢悢鍝勪户缂佽鲸甯為幏鐘诲箵閹哄棗浜鹃柛褎顨呴弰銉╂煟閹邦剚鎯堢紒鐙呯秮閺屻劑寮崶顭戞婵炲瓨绮岀紞濠傤潖濞差亜鎹舵い鎾跺Т缁楋繝鎮楅崷顓€褰掆€﹀畡鎵殾闁硅揪绠戠粻濠氭煕閹捐尪鍏岄柨娑欑矊閳规垿鍩ラ崱妤冧化闂佸啿鍢查悧鍡涙箒闂佸憡娲﹂崹閬嶅煕閹达附鐓曟繝闈涙椤忓瓨淇婇幓鎺旂Ш闁哄本鐩俊姝岊槻闁哄绋撻埀顒侇問閸犳捇宕濆鍥╃焿闁圭儤鏌￠崑鎾绘晲鎼粹€茬敖闂佸憡蓱閹瑰洤顫忓ú顏呭殟闁靛鍠氭禍顏囨婵炴潙鍚嬮婵囧緞婵炴儳鐗氶梺绋跨箳婵兘骞婇幘姹囧亼濞村吋娼欑粈瀣亜閹捐泛啸闁哄棭鍋婂缁樼瑹閳ь剙顭囪鐓ら柕鍫濇礌閸嬫挸顫濋崡鐑嗘毉婵烇絽娲ら敃顏堢嵁閺嶃劍濯撮柤鍙夌缚閸斿秹濡甸崟顖氬唨妞ゆ劦婢€閹寸兘姊洪崨濠勬噧缂佸鏁搁幑銏犫攽閸繃鐎冲┑鈽嗗灡濡炲灝顭囬幋锔解拺缂佸顑欓崕蹇斾繆椤愶絿绠撻柣锝囧厴閹囧醇閻斿嘲濡抽梻渚€娼ц墝闁瑰啿娲畷鎴﹀箻鐠囪尙鐫勯梺鍓插亝缁诲嫰藝閵�?儺娓婚柕鍫濇閻撱儲淇婇幓鎺斿ⅲ妞わ箑缍婇弻锛勪沪閸撗勫垱闂佺硶鏅涚€氭澘鐣峰鈧幃娆擃敆閸屾稒鐦旈梻鍌氬€峰ù鍥х暦閻㈢ǹ绐楅柟鐗堟緲缁€澶嬬箾閸℃绂嬫繛鍏肩墬缁绘稑顔忛鑽ゅ嚬闂佺ǹ顑呴崐鍧楃嵁閺嶎偄鍨濋柣鐔告緲閳峰鈹戦鍡欑ɑ闁告梹鐟ラ～蹇涙惞閸︻厾锛滃┑鈽嗗灣閸樠囧煕閸儲鈷戦柛娑樷看閻掑ジ鏌涢妷鈺婃缂佸绻樺Λ鍛搭敃閵忊€愁槱濠殿喖锕ら…鐑藉Υ閸涘瓨鍊婚柤鎭掑劚閳ь剛鏁婚弻銊モ攽閸℃瑥鍤紓浣靛姀婵倝濡甸崟顖涙櫆闁兼亽鍎抽崙鈥愁渻閵堝簼绨婚柛鐔风摠娣囧﹪宕奸弴鐐茶€垮┑鐐叉濞存艾顭囨搴ｇ＝闁�?本鐟чˇ锔姐亜閹存繃顥㈡鐐村灴瀹曟儼顦撮柡鍡畵閺屻劌鈹戦崱鈺傂﹀Δ鐘靛亼閸ㄨ櫣鎹㈠☉銏犵闁绘劕鐏氶崰娑㈡⒑閸︻厽鐒挎繛鍜冪悼濡叉劙骞樼拠鑼紲濠电偛妫欓崹鍨繆娴犲鐓㈤柛鎰靛幒閸氼偆绱掓潏銊ユ诞闁糕斁鍋撳銈嗗笒鐎氼剟鎮為崹顐犱簻闁圭儤鍨甸顏堟煃闁垮鐏╃紒杈ㄥ笧閳ь剨缍嗘禍�?堟儍閿涘嫧鍋撶憴鍕仩闁稿氦灏欓幑銏犫攽鐎ｎ亞鍔﹀銈嗗笒鐎氼參鎮為懖鈹惧亾楠炲灝鍔氶柟铏姍瀹曟繈鏁冮埀顒勨€旈崘顔嘉ч柛鈩冾殘閻熸劙姊洪悡搴℃毐闁绘牜鍘ч悾鐑筋敍閻愯尪鎽曢梺闈涱檧婵″洭宕㈤悽鍛娾拺闁告稑锕ら悘鐔兼煕婵犲啰澧遍柍褜鍓氶悢顒勫箯閿燂�?
                huart1.Lock = HAL_UNLOCKED;                                             // 闂傚倸鍊搁崐鎼佸磹閹间礁纾归柟闂寸绾惧綊鏌熼梻瀵割槮缁炬儳缍婇弻鐔兼⒒鐎靛壊妲紒鐐劤濠€閬嶅焵椤掑倹鍤€閻庢凹鍙冨畷宕囧鐎ｃ劋姹楅梺鍦劋閸ㄥ綊宕愰悙鐑樺仭婵犲﹤鍟扮粻鑽も偓娈垮枟婵炲﹪寮崘顔肩＜婵炴垶鑹鹃獮妤呮⒒娓氣偓濞佳呮崲閸℃稑绠犳慨妯挎硾閹硅埖銇勯幘璺盒ユ鐐存尭閳规垶骞婇柛濠冩礋楠炲﹨绠涘☉娆忎簵濠电偛妫欓幐濠氭偂濞嗘劗绠鹃柛顐ｇ箘娴犮垽鏌＄€ｎ偆鈯曢柕鍥у閺佹劙宕ㄩ顫垝闂備礁鎼張顒傜矙閹捐鐒垫い鎺戯功閸掓澘顭胯濞村嘲顕ｈ閸┾偓妞ゆ帒瀚崐鍨箾閸繄浠㈤柡瀣洴閺岋綁寮介銏犱粯闂佷紮绲块崗姗€骞冮埄鍐╁劅妞ゆ棁妫勯崗濠冧繆閻愵亜鈧牠骞愭ィ鍐ㄧ獥闁规儳绠嶆禍褰掓煕閵夈垺娅囩痪鍙ョ矙閺屾稓浠﹂崜褎鍣銈嗘煥椤︾敻寮诲☉姘ｅ亾閿濆骸浜濋悘蹇ｅ弮閺屽秶鎲撮崟顐や紝闂佽鍠掗弲鐘荤嵁閹捐绠抽柛鈩冦仦婢规洟姊洪崜鎻掍簼婵炲弶鐗犻幃鐐哄垂椤愮姳绨婚梺鐟版惈缁夊爼藝閿斿墽纾兼俊銈勭缁楁岸鏌曢崶褍顏い銏℃礋閺佹劙宕堕埡鍐╂緰闂傚倷娴囧銊╂倿閿曞倸绀夋繛鍡楃箳閺嗭箓鏌曟繛鐐珦闁轰礁妫濋弻宥堫檨闁告挾鍠曞Λ銏犫攽椤旇褰掑春閺嶎厼鐓曢柟杈鹃檮閸嬶綁鏌涢妷锝呭缂佽尙绮妵鍕箳鐎ｎ亞浠鹃梺闈涙搐鐎氭澘顕ｉ鈧崺鈧い鎺戝閸嬪鏌ｅΟ鍨毢闁哄棴绠戦湁闁�?繐鍚嬬紞鎴犵磼閻樺樊鐓奸柟顔肩秺瀹曞爼顢旈崟顓燁嚄婵＄偑鍊х€靛矂宕抽敐鍜佹綎闁惧繗顫夐崗婊堟煕濞戝崬鏋涙繛鎳峰懐纾藉ù锝呮惈鏍￠梺鎼炲妼閻忔繈顢氶敐澶婂窛濠电姴瀚幊婵嬫⒑闁偛鑻晶瀵糕偓娈垮枛椤兘骞冮姀銈嗗亗閹艰揪缍嗗Σ鍫曟煟閻斿摜鐭婄紒缁樺浮瀵偊顢欑亸鏍潔闂侀潧楠忕槐鏇㈠储閹间焦鈷戦柛娑橈梗缁堕亶鏌涢悩鎰佹疁鐎规洘鍔欓獮鍥偋閸垹骞愰梺璇茬箳閸嬬娀顢氳閹便劑宕掗悙瀵�?幍濡炪倖鏌ㄩ幖顐﹀焵椤掍胶绠撻柣锝囧厴楠炴帡骞嬮弮鈧～宥呪攽椤旂瓔娈旀俊顐ｆ⒒濡叉劙鏁撻敓锟�
                return_state = HAL_UART_Receive_IT(&huart1, &Action_ch, 1);// 闂傚倸鍊搁崐鎼佸磹閹间礁纾归柟闂寸绾惧綊鏌熼梻瀵割槮缁炬儳缍婇弻鐔兼⒒鐎靛壊妲紒鐐劤缂嶅﹪寮婚悢鍏尖拻閻庨潧澹婂Σ顔剧磼閻愵剙鍔ょ紓宥咃躬瀵鎮㈤崗灏栨嫽闁诲酣娼ф竟濠偽ｉ鍓х＜闁绘劦鍓欓崝銈囩磽瀹ュ拑韬€殿喖顭烽弫鎰緞婵犲嫷鍚呴梻浣瑰缁诲倿骞夊☉銏犵缂備焦顭囬崢杈ㄧ節閻㈤潧孝闁�?﹤缍婂畷鎴﹀Ψ閳哄倻鍘搁柣蹇曞仩椤曆勬叏閸屾壕鍋撳▓鍨灍婵炲吋鐟╅敐鐐测攽鐎ｎ偄娈濆┑鐐茬墕缁ㄩ亶宕戦幘璇插唨闁靛ě鍜佸晭闂佽瀛╃粙鎺椻€﹂崶顒佸剹濠电姴瀚壕鐣屸偓骞垮劚閹锋垿鐓鍌楀亾濞堝灝鏋︽い鏇嗗洤鐓″鑸靛姇椤懘鏌ｅΟ鍏兼毄闁哄鎮傚缁樻媴閸涢潧婀遍幑銏ゅ箛閺夎法顔戝┑鐘诧工閻楀棝寮告笟鈧弻鈥愁吋鎼粹€崇闂佹娊鏀遍崹鍓佹崲濞戙垺鍤戝Λ鐗堢箓濞堫厼螖閻橀潧浠︽い銊ワ躬瀵鎮㈤崗鐓庝画闂佺粯顨呴悧鍡涘几閻樼粯鍊垫繛鍫濈仢閺嬫稒銇勯鐘插幋鐎殿噮鍋婇獮鍥敇閻愮數鐛┑鐘垫暩婵鈧稈鏅濈槐鐐哄磼閻愮补鎷绘繛杈剧秬婵倝鎮甸鍫熺厱閹艰揪绲界敮鍫曟煃缂佹ɑ鐓ラ柍钘夘槸椤繃娼忛埡濠冃︽繝鐢靛Х閺佸憡鎱ㄩ弶鎳ㄦ椽濡堕崶鈺€绗夊銈嗙墱閸嬬偤鎮″▎鎾崇骇闁割偁鍎抽悾鐑樹繆缂併垹娅嶉柡灞剧〒閳ь剨缍嗘禍婊堫敂椤撱垺鐓欐い鏃囶潡閸︻厾涓嶆繛鎴炵懄閸庣喖鏌ㄥ┑鍡樺櫣妞ゎ剙顦靛缁樻媴閸涘﹥鍎撻梺绋匡功閺佽鐣烽幋锕€绠荤紓浣骨氶幏濠氭⒑缁嬫寧婀伴柣鐔村姂瀹曟鐣濋埀顒傛閹烘鏁嬮柛娑卞幘娴犳悂姊烘潪鎵槮妞ゆ垵顦甸獮鍐ㄎ旈埀顒勫煝閹捐鍨傛い鏃傛櫕娴滎亪姊绘担铏瑰笡闁绘娲熸俊鍫曞箹娴ｇ懓浠掑銈嗘磵閸嬫挾鈧鍠曠划娆撱€佸鈧幃娆撴偨閸偅绶繝纰夌磿閸嬫垿宕愰弽顓炶摕闁靛⿵闄勫▍鐘裁归悩宸剱闁哄拋鍓氱换婵囩節閸屾粌顤€闂佹娊鏀遍崹鍦閹惧瓨濯撮柛蹇擃槹閿涘牆顪冮妶鍛闁绘妫濋幃鍧楊敋閳ь剟寮诲☉�?庢Ъ濡炪們鍔岄幊姗€骞冮垾鏂ユ斀閻庯綆鍋嗛崢鎼佹⒑閹肩偛鍔橀柛搴ㄤ憾閹﹢顢旈崼鐔哄幗闂佽鍎抽顓灻洪幘顔界厵妞ゆ梹鏋婚懓鍧楁煙椤旂晫鎳囨俊顐㈠暙閳藉螖閳ь剟藟濮樿京纾介柛灞剧懆椤斿鏌涚€ｎ偅宕岄柡灞剧洴楠炲洭宕楅崫銉﹀瘻闂備胶枪椤戝棝骞戦崶褏鏆︾憸鐗堝俯閺佸啴鏌ㄥ┑鍡樻悙闁搞倖甯″铏规嫚閹绘帩鍔夐梺鍛婂灥缂嶅﹤鐣峰⿰鍫熷亜闁绘挸瀛╁Σ顒勬⒑闂堟侗妾х紒鐘冲灩濞嗐垽鎮欓悜妯煎幍闂備緡鍙忕粻鎴炴櫠缂佹绠鹃柣鎾冲嚱闊剚鎱ㄦ繝鍛仩闁逞屽墮濠€杈ㄦ叏閻㈡潌澶嬪緞鐎ｂ晝绠氬銈嗗姂閸ㄥ鎮為崫銉㈠亾鐟欏嫭绀冮柛銊ユ健閻涱喖顫滈埀顒勭嵁閸ャ劍濯撮柛娑橈工閳ь剦鍨伴埞鎴︽偐椤旇偐浼囧┑鐐差槹閻╊垶銆侀弽顓炵＜闁绘劘灏欓鍡椻攽閻愬弶鈻曞ù婊勭箞閸╂盯骞嬮敂鐣屽幈濠电偞鍨堕敃顐﹀礉閻旇櫣纾奸柣妯挎珪瀹曞矂鏌熼绛嬫當妞ゎ偅绻堥幃鈩冩償閿涘嫮娼夐梻鍌欐祰濡椼劎绮堟担铏圭煋闁荤喖鍋婇崵鏇熴亜閺囨浜鹃悗瑙勬礀閵堟悂骞冮姀銈呬紶闁告洦鍋嗛濂告⒒閸屾艾鈧绮堟笟鈧獮澶愭晸閻樻彃鐎銈嗙墱閸嬫稓澹曡ぐ鎺撶厸鐎广儱楠告禍鎰版煕鐎ｎ偅灏い顐ｇ箞閹瑩顢楅埀顒勵敂閿燂拷
            }
        }
    }
			
}

//void HAL_GPIO_EXTI_Callback(uint16_t GPIO_Pin) {
//    if (GPIO_Pin == NOTE_POSITION_Pin) {
//        x_pre = Robot.Robot_in_self.position_now.x;
//        y_pre = Robot.Robot_in_self.position_now.y;
//		yaw_pre_laser = yaw_pre = Robot.Robot_in_self.position_now.yaw;
//    }
//}
